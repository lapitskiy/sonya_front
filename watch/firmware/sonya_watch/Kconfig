## watch/firmware/sonya_watch/main/Kconfig
```kconfig
menu "Sonya Watch Configuration"

    config REC_SECONDS
        int "Recording duration (seconds)"
        default 4
        range 1 30
        help
            Fixed duration of audio recording after wake detection.

    config REC_STOP_ON_SILENCE
        bool "Stop recording on silence (WWE/CMD)"
        default y
        help
            If enabled, WWE/CMD recordings can end early when a long silence is detected.

    config REC_SILENCE_STOP_MS
        int "Silence duration to stop (ms)"
        default 3500
        range 500 10000
        depends on REC_STOP_ON_SILENCE
        help
            Stop WWE/CMD recording after this much consecutive silence.

    config REC_SILENCE_MIN_RECORD_MS
        int "Minimum record time before silence-stop (ms)"
        default 800
        range 0 5000
        depends on REC_STOP_ON_SILENCE
        help
            Ignore silence-stop until at least this much audio has been recorded.

    config REC_SILENCE_MAXABS_THRESH
        int "Silence threshold (maxAbs)"
        default 160
        range 10 5000
        depends on REC_STOP_ON_SILENCE
        help
            A 500ms window is considered silence when max absolute PCM sample value is below this threshold.

    config AUDIO_SR
        int "Audio sample rate (Hz)"
        default 16000
        help
            I2S microphone sample rate.

    config AUDIO_IN_GAIN_DB
        int "Microphone input gain (dB)"
        default 18
        range 0 30
        help
            Codec input gain in dB (esp_codec_dev_set_in_gain).
            If recording is too quiet, increase (e.g. 18..24). Too high can clip.

    config CHUNK_SIZE
        int "BLE TX chunk payload size (bytes)"
        default 180
        range 20 244
        help
            Max payload size for AUDIO_CHUNK frames. BLE MTU typically 244.

    choice WAKE_MODE
        prompt "Wake detection mode"
        default WAKE_MODE_CMD
        help
            How to trigger wake / start recording.

        config WAKE_MODE_CMD
            bool "CMD (RX 'START')"
        config WAKE_MODE_BUTTON
            bool "BUTTON (GPIO)"
        config WAKE_MODE_RMS
            bool "RMS (audio energy)"
        config WAKE_MODE_WWE
            bool "WWE (WakeNet wake word, esp-sr)"
        config WAKE_MODE_MULTI
            bool "MULTI (BUTTON + WWE)"
    endchoice

    config WAKE_BUTTON_GPIO
        int "Wake button GPIO (for BUTTON mode)"
        default 0
        help
            GPIO for wake button. ESP32-S3 BOOT button is typically GPIO 0.

    config WAKE_BUTTON_ACTIVE_HIGH
        bool "Button active high (pressed = GPIO high)"
        default n
        depends on WAKE_MODE_BUTTON || WAKE_MODE_MULTI
        help
            n = active-low: BOOT typical, press=0 release=1. y = press=1 release=0.

    config RMS_THRESHOLD
        int "RMS threshold for wake (for RMS mode)"
        default 500
        range 100 10000
        help
            Audio energy threshold. Exceed to trigger wake.

    config WAKENET_THRESHOLD_X10000
        int "WakeNet threshold (x10000, lower = more sensitive)"
        default 5200
        range 4000 9999
        depends on WAKE_MODE_WWE || WAKE_MODE_MULTI
        help
            WakeNet wake-word detection threshold.
            Range is 0.4000..0.9999, encoded as integer *10000.
            Example: 5200 => 0.52. Lower = higher recall, more false wakes.

    config DEVICE_NAME
        string "BLE device name"
        default "SONYA-WATCH"
        help
            BLE advertising name.

    config STATUS_LED_GPIO
        int "Status LED GPIO (-1 to disable)"
        default -1
        range -1 48
        help
            Optional GPIO for a simple status indicator (LED/backlight pin).
            Patterns:
              - advertising (not connected): slow blink
              - connected: solid ON
              - recording: fast blink
              - error: triple blink burst

    config STATUS_LED_ACTIVE_LEVEL
        int "Status LED active level (0/1)"
        default 1
        range 0 1
        help
            Some boards wire LEDs as active-low. Set 0 for active-low, 1 for active-high.

    config STATUS_SCREEN_ENABLE
        bool "Enable simple status screen (AMOLED)"
        default y
        help
            Initialize AMOLED via QSPI and render a simple status indicator:
              - advertising (not connected): blue (slow blink)
              - connected: green (solid)
              - recording: red (fast blink)
              - error: magenta (triple blink burst)

    config UI_LVGL_ENABLE
        bool "Enable LVGL UI (icons/menus)"
        default n
        help
            Use LVGL-based UI (separate module) instead of the simple status screen.
            This is intended for future menus/icons and touch UI.

    config I2S_BCK_GPIO
        int "I2S BCK GPIO"
        default 41
        help
            I2S bit clock. Waveshare: GPIO 41.

    config I2S_WS_GPIO
        int "I2S WS (LRCK) GPIO"
        default 45
        help
            I2S word select. Waveshare: GPIO 45.

    config I2S_DIN_GPIO
        int "I2S DIN (data in) GPIO"
        default 42
        help
            I2S data input from mic. Waveshare: GPIO 42.

    config I2S_MCLK_GPIO
        int "I2S MCLK GPIO"
        default 16
        help
            I2S master clock. Waveshare: GPIO 16. Use -1 to disable.

    config I2C_SDA_GPIO
        int "I2C SDA GPIO"
        default 15
        help
            I2C SDA for codec/touch. Waveshare ESP32-S3 Touch AMOLED 2.06: GPIO 15.

    config I2C_SCL_GPIO
        int "I2C SCL GPIO"
        default 14
        help
            I2C SCL for codec/touch. Waveshare ESP32-S3 Touch AMOLED 2.06: GPIO 14.

endmenu
```

## watch/firmware/sonya_watch/sdkconfig.defaults
```kconfig
CONFIG_IDF_TARGET="esp32s3"
CONFIG_PARTITION_TABLE_CUSTOM=y
CONFIG_PARTITION_TABLE_CUSTOM_FILENAME="partitions.csv"

# Flash size (Waveshare ESP32-S3 Touch AMOLED 2.06 is typically >= 8MB flash)
CONFIG_ESPTOOLPY_FLASHSIZE_8MB=y

# Default wake mode: allow both button and wake phrase
CONFIG_WAKE_MODE_MULTI=y

# NimBLE (not Bluedroid)
CONFIG_BT_ENABLED=y
CONFIG_BT_NIMBLE_ENABLED=y
CONFIG_BT_BLUEDROID_ENABLED=n
CONFIG_BT_NIMBLE_MAX_CONNECTIONS=1
CONFIG_BT_NIMBLE_ROLE_CENTRAL=n
CONFIG_BT_NIMBLE_ROLE_OBSERVER=n
CONFIG_BT_NIMBLE_ROLE_BROADCASTER=y
CONFIG_BT_NIMBLE_ROLE_PERIPHERAL=y

# Enable PSRAM so we can buffer audio safely
CONFIG_SPIRAM=y
CONFIG_SPIRAM_MODE_OCT=y
CONFIG_SPIRAM_SPEED_80M=y
CONFIG_SPIRAM_USE_MALLOC=y

# NimBLE buffers: increase to avoid ENOMEM during audio notify bursts
CONFIG_BT_NIMBLE_MSYS_1_BLOCK_COUNT=32
CONFIG_BT_NIMBLE_MSYS_2_BLOCK_COUNT=48
CONFIG_BT_NIMBLE_TRANSPORT_ACL_FROM_LL_COUNT=48

# WakeNet (esp-sr): pick at least one wake phrase, otherwise wakenet_model_name is NULL and wake_init fails.
# Wake phrase: "Hi Joy"
CONFIG_SR_WN_WN9_HIJOY_TTS=y

# UI: LVGL (kept isolated, status_ui routes to it)
CONFIG_UI_LVGL_ENABLE=y

# LVGL fonts: make UI readable + allow symbol icons to be visible
CONFIG_LV_FONT_MONTSERRAT_20=y
CONFIG_LV_FONT_MONTSERRAT_28=y

# LVGL widgets used by UI
CONFIG_LV_USE_GIF=y

# Keep firmware small: do not compile LVGL examples/demos
# (we only use the library itself)
# Note: must be applied via sdkconfig (defaults fill missing options).
CONFIG_LV_BUILD_EXAMPLES=n
CONFIG_LV_BUILD_DEMOS=n

# Decode embedded PNG assets for lv_image
CONFIG_LV_USE_LODEPNG=y

# LVGL memory: use system malloc (PSRAM-capable) instead of tiny built-in pool
CONFIG_LV_USE_CLIB_MALLOC=y
```

## watch/firmware/waveshare_esp32s3_147/sdkconfig.defaults
```kconfig
CONFIG_NO_MIC_MODE=y
CONFIG_WAKE_MODE_BUTTON=y
CONFIG_WAKE_BUTTON_GPIO=0
CONFIG_WAKE_BUTTON_ACTIVE_HIGH=n
```
